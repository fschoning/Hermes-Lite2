/* SPDX-License-Identifier: Apache-2.0
 * Copyright 2026 Franz Schöning, https://www.schoning.com
 */
/* Raw front-end firmware for hl2b5up_raw: the message layer (msg.c) on the HL2, with the HL2 hardware
 * layer (packet ring, timer) and the request handlers for the front-end I/O block (rtl/hl2io.v).
 * Protocol and message set: docs/rawfront/PROTOCOL.md. Everything here is also reachable through the
 * layer-1 register bridge without this firmware; the firmware adds reliable delivery, I2C transfers and
 * scans in one request, telemetry and events.
 *
 * Datagrams: the application reads the receive ring itself (packet interrupt off). A datagram that is not
 * a message ('H') is left for the boot ROM (console, gdb): the application hands the ring over by setting
 * the ROM's read position and enabling the packet interrupt, and takes it back once the ROM has read
 * everything. The ROM's variable addresses come from the boot ROM ELF (rom_syms.h, generated by build.py).
 *
 * The main loop polls (no timer interrupt: the boot ROM's trap path costs more than the poll). The CPU
 * watchdog is kicked from the main loop: a hung firmware stops transmit through the interlock.
 */

#include "hl2cpu.h"
#include "hl2io.h"
#include "msg.h"
#include "rom_syms.h"

#define FW_VERSION  0x00030001u

extern void irq_off(void);
extern void irq_on(void);

uint32_t hal_ms(void) { return REG(SYS_MS); }

/* ------------------------------------------------------------------ packets */

#define PB(i) ((uint8_t)PBUF(PBUF_RX + ((i) & PBUF_RX_MASK)))

static uint16_t rx_rd;
static uint8_t  handed;                     /* receive ring handed to the boot ROM */
static uint8_t  rx_buf[HM_HDR_SIZE + HM_MAX_PAYLOAD];

void hal_send(const uint8_t *d, uint32_t n)
{
    uint32_t t0 = hal_ms(), s;
    while (((s = REG(PKT_TX_LEN)) & TX_BUSY) && hal_ms() - t0 < 20) ;
    if ((s & (TX_BUSY | TX_DEST)) != TX_DEST || n > PBUF_TX_SIZE) return;
    irq_off();                              /* the boot ROM may also send while it has the ring */
    for (uint32_t i = 0; i < n; i++) PBUF(PBUF_TX + i) = d[i];
    REG(PKT_TX_LEN) = n;
    irq_on();
}

static void rx_poll(void)
{
    if (handed) {
        if (REG(PKT_RX_RD) != REG(PKT_RX_WR)) return;
        REG(SYS_IRQ_EN) = 0;                /* the ROM has read everything: take the ring back */
        rx_rd = REG(PKT_RX_RD);
        handed = 0;
    }
    while (rx_rd != REG(PKT_RX_WR)) {
        uint32_t n = PB(rx_rd) | (PB(rx_rd + 1) << 8);
        if (n > 510) {                      /* out of step: skip everything waiting */
            REG(PKT_RX_RD) = rx_rd = REG(PKT_RX_WR);
            return;
        }
        if (n == 0 || PB(rx_rd + 2) != 'H') {
            irq_off();
            ROM_RX_RD = rx_rd;              /* console or gdb datagram: the boot ROM reads from here */
            ROM_RX_LEFT = 0;
            handed = 1;
            REG(SYS_IRQ_EN) = IRQ_PKT;
            irq_on();
            return;
        }
        for (uint32_t i = 0; i < n && i < sizeof(rx_buf); i++) rx_buf[i] = PB(rx_rd + 2 + i);
        rx_rd = (rx_rd + 2 + n) & 1023;
        REG(PKT_RX_RD) = rx_rd;
        if (n <= sizeof(rx_buf)) msg_input(rx_buf, n);
    }
}

/* ------------------------------------------------------------------ requests */

static uint32_t wait_cmd_idle(void)
{
    uint32_t t0 = hal_ms();
    while (REG(IO_CMD_ADDR) & IO_CMD_BUSY)
        if (hal_ms() - t0 > 50) return 0;
    return 1;
}

/* One I2C transfer through the register block. Returns 0 ok, 1 NACK, 2 refused by the bias guard,
   3 dropped (engine busy), 4 timeout; *data = bytes read. */
static uint32_t i2c_xfer(uint32_t word, uint32_t *data)
{
    uint32_t st = REG(IO_I2C_STATUS), done = (st >> 16) & 0xFF, ref = st >> 24, t0;
    if (!wait_cmd_idle()) return 4;
    REG(IO_I2C_XFER) = word;
    t0 = hal_ms();
    while (hal_ms() - t0 < 250) {
        st = REG(IO_I2C_STATUS);
        if (((st >> 16) & 0xFF) != done) {
            *data = REG(IO_I2C_RDATA);
            return (st & IO_I2C_NACK) ? 1 : 0;
        }
        if ((st >> 24) != ref) return (st & IO_I2C_REFUSED) ? 2 : 3;
    }
    return 4;
}

static int reg_write_ok(uint32_t a)
{
    uint32_t hi = a >> 16;
    return a >= RAM_SIZE && hi != 1 && hi != (PKT_BASE >> 16) && hi != (FL_BASE >> 16);
}

uint32_t app_request(uint8_t cls, uint8_t op, const uint8_t *b, uint32_t len, uint8_t *o, uint32_t max)
{
    uint32_t v, n, i, r = 1;
    o[0] = HM_OK;

    switch (cls << 8 | op) {
    case HM_C_SYS << 8 | 1:                 /* HELLO */
        o[1] = HM_VERSION;
        o[2] = o[3] = 0;
        hm_put32(o + 4, REG(STAT_VERSION));
        hm_put32(o + 8, FW_VERSION);
        hm_put32(o + 12, REG(STAT_CAPS));
        hm_put16(o + 16, HM_MAX_PAYLOAD);
        hm_put16(o + 18, msg_telemetry_period());
        hm_put32(o + 20, REG(IO_ID));
        return 24;
    case HM_C_SYS << 8 | 2:                 /* PING: body echoed */
        for (i = 0; i < len && i + 1 < max; i++) o[1 + i] = b[i];
        return 1 + i;
    case HM_C_SYS << 8 | 3:                 /* TELEMETRY period (u16 ms, 0 off) */
        if (len < 2) break;
        msg_set_telemetry(hm_get16(b));
        return 1;

    case HM_C_REG << 8 | 1:                 /* READ addr, count */
        if (len < 5 || b[4] == 0 || b[4] > 32 || 1 + 4u * b[4] > max) break;
        for (v = hm_get32(b), i = 0; i < b[4]; i++, v += 4) hm_put32(o + 1 + 4 * i, REG(v));
        return 1 + 4 * i;
    case HM_C_REG << 8 | 2:                 /* WRITE addr, values */
        if (len < 8 || (len & 3)) break;
        for (v = hm_get32(b), i = 4; i < len; i += 4, v += 4) {
            if (!reg_write_ok(v)) { o[0] = HM_E_REFUSED; break; }
            REG(v) = hm_get32(b + i);
        }
        o[1] = (i - 4) / 4;
        return 2;

    case HM_C_I2C << 8 | 1:                 /* XFER bus, address, flags (1 read, 2 probe), register, value */
        if (len < 5 || b[0] < 1 || b[0] > 3) break;
        o[1] = i2c_xfer((uint32_t)b[0] << 30 | ((b[2] & 1) ? IO_I2C_READ : 0) | ((b[2] & 2) ? IO_I2C_READ | IO_I2C_PROBE : 0) |
                        (b[1] & 0x7Fu) << 16 | (uint32_t)b[3] << 8 | b[4], &v);
        hm_put32(o + 2, v);
        return 6;
    case HM_C_I2C << 8 | 2:                 /* SCAN bus, first, last: 16-byte bitmap of acknowledging addresses */
        if (len < 3 || b[0] < 1 || b[0] > 3 || b[2] > 127 || max < 17) break;
        for (i = 1; i < 17; i++) o[i] = 0;
        for (i = b[1]; i <= b[2]; i++) {
            n = i2c_xfer((uint32_t)b[0] << 30 | IO_I2C_READ | IO_I2C_PROBE | i << 16, &v);
            if (n == 0) o[1 + i / 8] |= 1 << (i % 8);
            else if (n > 1) o[0] = HM_E_BUSY;
            REG(IO_WDOG) = IO_WDOG_KEY;
        }
        return 17;

    case HM_C_RF << 8 | 1:                  /* TX_PERMIT flags: renews the transmit lease */
        if (len < 1) break;
        REG(IO_TX_PERMIT) = IO_PERMIT_KEY | (b[0] & 7);
        hm_put32(o + 1, REG(IO_ILK_STATUS));
        return 5;
    case HM_C_RF << 8 | 2:                  /* CLEAR_TRIPS */
        REG(IO_ILK_CLEAR) = IO_CLEAR_KEY;
        hm_put32(o + 1, REG(IO_ILK_STATUS));
        return 5;
    case HM_C_RF << 8 | 3:                  /* BIAS_UNLOCK u8 */
        if (len < 1) break;
        REG(IO_BIAS_UNLOCK) = b[0] ? IO_BIAS_KEY : 0;
        return 1;
    case HM_C_RF << 8 | 4:                  /* CMD address u8, value u32: command bus */
        if (len < 5 || b[0] > 63) break;
        if (!wait_cmd_idle()) { o[0] = HM_E_BUSY; return 1; }
        REG(IO_CMD_DATA) = hm_get32(b + 1);
        REG(IO_CMD_ADDR) = b[0];
        return 1;
    case HM_C_RF << 8 | 5:                  /* LIMITS lease ms, max key-down s, temperature code (0 = keep) */
        if (len < 6) break;
        if ((v = hm_get16(b))) REG(IO_LEASE_MS) = v;
        if ((v = hm_get16(b + 2))) REG(IO_MAXKEY_S) = v;
        if ((v = hm_get16(b + 4))) REG(IO_TEMP_LIMIT) = v;
        hm_put16(o + 1, REG(IO_LEASE_MS));
        hm_put16(o + 3, REG(IO_MAXKEY_S));
        hm_put16(o + 5, REG(IO_TEMP_LIMIT));
        return 7;
    default:
        o[0] = HM_E_UNKNOWN;
        return 1;
    }
    o[0] = HM_E_LENGTH;
    return r;
}

uint32_t app_telemetry(uint8_t *o, uint32_t max)
{
    if (max < 36) return 0;
    hm_put32(o, hal_ms());
    hm_put16(o + 4, REG(STAT_TEMP));
    hm_put16(o + 6, REG(STAT_FWD));
    hm_put16(o + 8, REG(STAT_REV));
    hm_put16(o + 10, REG(STAT_BIAS));
    hm_put32(o + 12, REG(IO_INPUTS));
    hm_put32(o + 16, REG(IO_ILK_STATUS));
    hm_put32(o + 20, REG(IO_I2C_STATUS));
    hm_put32(o + 24, REG(IO_FAN));
    hm_put32(o + 28, REG(IO_KEYTIME));
    hm_put32(o + 32, REG(STAT_TXSTAT) | REG(PKT_COUNT) << 8);
    return 36;
}

static uint32_t ev_state;

/* event when the transmit state, a trip reason, a cut-off or a debounced input changes */
uint32_t app_event(uint8_t *o, uint32_t max)
{
    uint32_t ilk = REG(IO_ILK_STATUS), in = REG(IO_INPUTS);
    uint32_t s = (ilk & 0x073E3F7B) ^ ((in >> 16) & 7) << 28;   /* lease-valid bits excluded: they follow the renewals */
    if (s == ev_state || max < 12) return 0;
    ev_state = s;
    hm_put32(o, ilk);
    hm_put32(o + 4, in);
    hm_put32(o + 8, hal_ms());
    return 12;
}

int main(void)
{
    REG(SYS_IRQ_EN) = 0;                    /* the application reads the receive ring itself */
    rx_rd = REG(PKT_RX_RD);
    REG(IO_WDOG) = IO_WDOG_KEY;
    msg_init(REG(SYS_MS) * 2654435761u ^ REG(SYS_STATUS) << 20 ^ FW_VERSION);
    ev_state = ~0u;

    for (;;) {
        REG(IO_WDOG) = IO_WDOG_KEY;
        rx_poll();
        msg_poll();
    }
}
