//
//  gl_console.v — debug console on the on-board USB-UART (BL616), 115200 8N1.
//
//  Prints one status line every PERIOD_CYCLES (LINK_SPEC.md section 11) and a help line
//  at power-up and on 'h'. The line layout comes from gl_console_fmt.vh (generated by
//  gowin/tools/gen_console_fmt.py); the value vector from gl_console_fields.vh.
//
//  Before each line 'snap_t' toggles and the console waits for 'snap_done_t' so that the
//  accumulator shadow registers in the lane clock domain are stable; then all fields
//  are latched and printed.
//
//  Single-character commands on the receive side give one-cycle pulses.
//
module gl_console #(
  parameter integer CLK_HZ        = 50000000,
  parameter integer BAUD          = 115200,
  parameter integer PERIOD_CYCLES = 50000000,
  parameter integer LANES         = 6
) (
  input              clk,
  input              rxd,
  output             txd,
  // commands
  output reg         cmd_train   = 1'b0,
  output reg         cmd_prbs    = 1'b0,
  output reg         cmd_live    = 1'b0,
  output reg         cmd_counter = 1'b0,
  output reg         cmd_toggle  = 1'b0,
  output reg         cmd_scr     = 1'b0,
  output reg         cmd_rst     = 1'b0,
  output reg         cmd_x       = 1'b0,   // send a test openHPSDR command
  // snapshot handshake with the lane clock domain
  output reg         snap_t      = 1'b0,
  input              snap_done_t,
  // values
  input  [3:0]       f_st,
  input  [3:0]       f_fail,
  input  [3:0]       f_mode,
  input  [3:0]       f_scr,
  input  [3:0]       f_clk,
  input  [3:0]       f_pll,
  input  [3:0]       f_swap,
  input  [3:0]       f_rev,
  input  [3:0]       f_salive,
  input  [47:0]      f_tap,
  input  [47:0]      f_eye,
  input  [23:0]      f_off,
  input  [191:0]     f_err,
  input  [39:0]      f_words,
  input  [31:0]      f_werr,
  input  [15:0]      f_sf,
  input  [15:0]      f_se,
  input  [15:0]      f_tx,
  input  [255:0]     f_hl2
);

`include "gl_console_fmt.vh"
`include "gl_console_fields.vh"

// ---------------------------------------------------------------- receive: commands
wire [7:0] rx_data;
wire       rx_valid;
reg        help_req = 1'b1;    // print the help line at power-up
reg        help_taken = 1'b0;

gowinlink_uart_rx #(.CLK_HZ(CLK_HZ), .BAUD(BAUD)) uart_rx_i (
  .clk(clk), .rxd(rxd), .data(rx_data), .valid(rx_valid)
);

always @(posedge clk) begin
  cmd_train   <= 1'b0;
  cmd_prbs    <= 1'b0;
  cmd_live    <= 1'b0;
  cmd_counter <= 1'b0;
  cmd_toggle  <= 1'b0;
  cmd_scr     <= 1'b0;
  cmd_rst     <= 1'b0;
  cmd_x       <= 1'b0;
  if (rx_valid) begin
    case (rx_data)
      8'h74: cmd_train   <= 1'b1;   // t
      8'h70: cmd_prbs    <= 1'b1;   // p
      8'h6C: cmd_live    <= 1'b1;   // l
      8'h63: cmd_counter <= 1'b1;   // c
      8'h6F: cmd_toggle  <= 1'b1;   // o
      8'h73: cmd_scr     <= 1'b1;   // s
      8'h72: cmd_rst     <= 1'b1;   // r
      8'h68: help_req    <= 1'b1;   // h
      8'h78: cmd_x       <= 1'b1;   // x
      default: ;
    endcase
  end
  if (help_taken) help_req <= 1'b0;
end

// ---------------------------------------------------------------- transmit: line printer
wire snap_done;
gl_tog2pulse s_sd (.clk(clk), .t(snap_done_t), .p(snap_done));

reg [7:0]  tx_data  = 8'h00;
reg        tx_valid = 1'b0;
wire       tx_ready;
gowinlink_uart_tx #(.CLK_HZ(CLK_HZ), .BAUD(BAUD)) uart_tx_i (
  .clk(clk), .data(tx_data), .valid(tx_valid), .ready(tx_ready), .txd(txd)
);

localparam [2:0] P_IDLE = 3'd0, P_SNAP = 3'd1, P_LOAD = 3'd2, P_EMIT = 3'd3, P_NEXT = 3'd4;
reg [2:0]  ps       = P_IDLE;
reg [31:0] ptmr     = 32'd0;
reg        is_help  = 1'b0;
reg [FMT_FIELDS_W-1:0] fields_l = {FMT_FIELDS_W{1'b0}};
reg [7:0]  segi     = 8'd0;
reg [5:0]  pos      = 6'd0;
reg [18:0] seg      = 19'd0;
reg [15:0] snap_to  = 16'd0;

wire [18:0] seg_cur = is_help ? fmt_segh(segi) : (LANES == 6) ? fmt_seg6(segi) : fmt_seg3(segi);
wire [7:0]  nseg    = is_help ? FMT_NSEGH : (LANES == 6) ? FMT_NSEG6 : FMT_NSEG3;

wire        seg_hex = seg[18];
wire [5:0]  seg_len = seg[17:12];
wire [11:0] seg_off = seg[11:0];
wire [11:0] nib_off = seg_off + 4 * (seg_len - 1 - pos);
wire [3:0]  nib     = fields_l[nib_off +: 4];
wire [7:0]  hexchar = (nib < 4'd10) ? (8'h30 + nib) : (8'h37 + nib);
wire [7:0]  ch      = seg_hex ? hexchar : fmt_lit(seg_off + pos);

always @(posedge clk) begin
  help_taken <= 1'b0;
  case (ps)
    P_IDLE: begin
      tx_valid <= 1'b0;
      if (help_req) begin
        is_help    <= 1'b1;
        help_taken <= 1'b1;
        segi       <= 8'd0;
        pos        <= 6'd0;
        ps         <= P_LOAD;
      end else if (ptmr >= PERIOD_CYCLES - 1) begin
        ptmr    <= 32'd0;
        is_help <= 1'b0;
        snap_t  <= ~snap_t;
        snap_to <= 16'd0;
        ps      <= P_SNAP;
      end else begin
        ptmr <= ptmr + 32'd1;
      end
    end
    P_SNAP: begin
      snap_to <= snap_to + 16'd1;
      if (snap_done || snap_to == 16'hFFFF) begin
        fields_l <= fields;
        segi     <= 8'd0;
        pos      <= 6'd0;
        ps       <= P_LOAD;
      end
    end
    P_LOAD: begin
      if (segi == nseg) begin
        ps <= P_IDLE;
      end else begin
        seg <= seg_cur;
        pos <= 6'd0;
        ps  <= P_EMIT;
      end
    end
    P_EMIT: begin
      tx_data  <= ch;
      tx_valid <= 1'b1;
      ps       <= P_NEXT;
    end
    P_NEXT: begin
      if (tx_valid && tx_ready) begin
        tx_valid <= 1'b0;
        if (pos == seg_len - 1) begin
          segi <= segi + 8'd1;
          ps   <= P_LOAD;
        end else begin
          pos <= pos + 6'd1;
          ps  <= P_EMIT;
        end
      end
    end
    default: ps <= P_IDLE;
  endcase
end

endmodule
